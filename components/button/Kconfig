## components/button/Kconfig
```kconfig
menu "Button Configuration"
  orsource "$IDF_PATH/examples/common_components/env_caps/$IDF_TARGET/Kconfig.env_caps"
  config ENABLE_BUTTON
    bool "Enable Button"
    default y
    help
      Enable or disable button
endmenu
```

## components/buzzer/Kconfig
```kconfig
menu "Buzzer Configuration"
  orsource "$IDF_PATH/examples/common_components/env_caps/$IDF_TARGET/Kconfig.env_caps"
  config ENABLE_BUZZER
    bool "Enable Buzzer"
    default y
    help
      Enable or disable buzzer
endmenu
```

## components/led/Kconfig
```kconfig
menu "LED Configuration"
  orsource "$IDF_PATH/examples/common_components/env_caps/$IDF_TARGET/Kconfig.env_caps"
  config ENABLE_LED
    bool "Enable LED"
    default y
    help
      Enable or disable LED
endmenu
```

## main/Kconfig.projbuild
```kconfig
menu "Project"
  orsource "$IDF_PATH/examples/common_components/env_caps/$IDF_TARGET/Kconfig.env_caps"
  config LED_USB_PIN
    int "Set Led Pin Of The USB Button"
    default 48
    help
      Set Led Pin Of The USB Button
  config LED_AC_PIN
    int "Set Led Pin Of The AC Button"
    default 38
    help
      Set Led Pin Of The AC Button
  config LED_DC_PIN
    int "Set Led Pin Of The DC Button"
    default 40
    help
      Set Led Pin Of The DC Button
endmenu
```
